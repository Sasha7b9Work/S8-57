const unsigned char fontGOST28[7996] =
{
/* 0x00 */   0x00, 0x00,
/* 0x01 */   0x00, 0x00,
/* 0x02 */   0x00, 0x00,
/* 0x03 */   0x00, 0x00,
/* 0x04 */   0x00, 0x00,
/* 0x05 */   0x00, 0x00,
/* 0x06 */   0x00, 0x00,
/* 0x07 */   0x00, 0x00,
/* 0x08 */   0x00, 0x00,
/* 0x09 */   0x00, 0x00,
/* 0x0A */   0x00, 0x00,
/* 0x0B */   0x00, 0x00,
/* 0x0C */   0x00, 0x00,
/* 0x0D */   0x00, 0x00,
/* 0x0E */   0x00, 0x00,
/* 0x0F */   0x00, 0x00,
/* 0x10 */   0x00, 0x00,
/* 0x11 */   0x00, 0x00,
/* 0x12 */   0x00, 0x00,
/* 0x13 */   0x00, 0x00,
/* 0x14 */   0x00, 0x00,
/* 0x15 */   0x00, 0x00,
/* 0x16 */   0x00, 0x00,
/* 0x17 */   0x00, 0x00,
/* 0x18 */   0x00, 0x00,
/* 0x19 */   0x00, 0x00,
/* 0x1A */   0x00, 0x00,
/* 0x1B */   0x00, 0x00,
/* 0x1C */   0x00, 0x00,
/* 0x1D */   0x00, 0x00,
/* 0x1E */   0x00, 0x00,
/* 0x1F */   0x00, 0x00,
/* 0x20 */   0x00, 0x02,
/* 0x21 */   0x07, 0x02,
/* 0x22 */   0x23, 0x02,
/* 0x23 */   0x2B, 0x02,
/* 0x24 */   0x79, 0x02,
/* 0x25 */   0xB6, 0x02,
/* 0x26 */   0x1D, 0x03,
/* 0x27 */   0x6B, 0x03,
/* 0x28 */   0x75, 0x03,
/* 0x29 */   0x93, 0x03,
/* 0x2A */   0xB1, 0x03,
/* 0x2B */   0xC6, 0x03,
/* 0x2C */   0xE1, 0x03,
/* 0x2D */   0xE9, 0x03,
/* 0x2E */   0xF0, 0x03,
/* 0x2F */   0xF5, 0x03,
/* 0x30 */   0x32, 0x04,
/* 0x31 */   0x67, 0x04,
/* 0x32 */   0x83, 0x04,
/* 0x33 */   0xB8, 0x04,
/* 0x34 */   0xED, 0x04,
/* 0x35 */   0x22, 0x05,
/* 0x36 */   0x57, 0x05,
/* 0x37 */   0x8C, 0x05,
/* 0x38 */   0xC1, 0x05,
/* 0x39 */   0xF6, 0x05,
/* 0x3A */   0x2B, 0x06,
/* 0x3B */   0x39, 0x06,
/* 0x3C */   0x4B, 0x06,
/* 0x3D */   0x66, 0x06,
/* 0x3E */   0x79, 0x06,
/* 0x3F */   0x94, 0x06,
/* 0x40 */   0xC9, 0x06,
/* 0x41 */   0x30, 0x07,
/* 0x42 */   0x65, 0x07,
/* 0x43 */   0x9A, 0x07,
/* 0x44 */   0xCF, 0x07,
/* 0x45 */   0x04, 0x08,
/* 0x46 */   0x39, 0x08,
/* 0x47 */   0x6E, 0x08,
/* 0x48 */   0xA3, 0x08,
/* 0x49 */   0xD8, 0x08,
/* 0x4A */   0xF4, 0x08,
/* 0x4B */   0x29, 0x09,
/* 0x4C */   0x5E, 0x09,
/* 0x4D */   0x93, 0x09,
/* 0x4E */   0xE1, 0x09,
/* 0x4F */   0x16, 0x0A,
/* 0x50 */   0x4B, 0x0A,
/* 0x51 */   0x80, 0x0A,
/* 0x52 */   0xB5, 0x0A,
/* 0x53 */   0xEA, 0x0A,
/* 0x54 */   0x1F, 0x0B,
/* 0x55 */   0x54, 0x0B,
/* 0x56 */   0x89, 0x0B,
/* 0x57 */   0xBE, 0x0B,
/* 0x58 */   0x0C, 0x0C,
/* 0x59 */   0x41, 0x0C,
/* 0x5A */   0x76, 0x0C,
/* 0x5B */   0xAB, 0x0C,
/* 0x5C */   0xC9, 0x0C,
/* 0x5D */   0x06, 0x0D,
/* 0x5E */   0x24, 0x0D,
/* 0x5F */   0x2B, 0x0D,
/* 0x60 */   0x32, 0x0D,
/* 0x61 */   0x80, 0x0D,
/* 0x62 */   0xA7, 0x0D,
/* 0x63 */   0xDC, 0x0D,
/* 0x64 */   0x03, 0x0E,
/* 0x65 */   0x38, 0x0E,
/* 0x66 */   0x5F, 0x0E,
/* 0x67 */   0x7B, 0x0E,
/* 0x68 */   0xB0, 0x0E,
/* 0x69 */   0xE5, 0x0E,
/* 0x6A */   0x01, 0x0F,
/* 0x6B */   0x24, 0x0F,
/* 0x6C */   0x59, 0x0F,
/* 0x6D */   0x75, 0x0F,
/* 0x6E */   0xAE, 0x0F,
/* 0x6F */   0xD5, 0x0F,
/* 0x70 */   0xFC, 0x0F,
/* 0x71 */   0x31, 0x10,
/* 0x72 */   0x66, 0x10,
/* 0x73 */   0x8D, 0x10,
/* 0x74 */   0xB4, 0x10,
/* 0x75 */   0xD0, 0x10,
/* 0x76 */   0xF7, 0x10,
/* 0x77 */   0x1E, 0x11,
/* 0x78 */   0x57, 0x11,
/* 0x79 */   0x7E, 0x11,
/* 0x7A */   0xB3, 0x11,
/* 0x7B */   0xDA, 0x11,
/* 0x7C */   0xF8, 0x11,
/* 0x7D */   0x14, 0x12,
/* 0x7E */   0x32, 0x12,
/* 0x7F */   0x00, 0x00,
/* 0x80 */   0x00, 0x00,
/* 0x81 */   0x00, 0x00,
/* 0x82 */   0x00, 0x00,
/* 0x83 */   0x00, 0x00,
/* 0x84 */   0x00, 0x00,
/* 0x85 */   0x00, 0x00,
/* 0x86 */   0x00, 0x00,
/* 0x87 */   0x00, 0x00,
/* 0x88 */   0x00, 0x00,
/* 0x89 */   0x00, 0x00,
/* 0x8A */   0x00, 0x00,
/* 0x8B */   0x00, 0x00,
/* 0x8C */   0x00, 0x00,
/* 0x8D */   0x00, 0x00,
/* 0x8E */   0x00, 0x00,
/* 0x8F */   0x00, 0x00,
/* 0x90 */   0x00, 0x00,
/* 0x91 */   0x00, 0x00,
/* 0x92 */   0x00, 0x00,
/* 0x93 */   0x00, 0x00,
/* 0x94 */   0x00, 0x00,
/* 0x95 */   0x00, 0x00,
/* 0x96 */   0x00, 0x00,
/* 0x97 */   0x00, 0x00,
/* 0x98 */   0x00, 0x00,
/* 0x99 */   0x00, 0x00,
/* 0x9A */   0x00, 0x00,
/* 0x9B */   0x00, 0x00,
/* 0x9C */   0x00, 0x00,
/* 0x9D */   0x00, 0x00,
/* 0x9E */   0x00, 0x00,
/* 0x9F */   0x00, 0x00,
/* 0xA0 */   0x00, 0x00,
/* 0xA1 */   0x00, 0x00,
/* 0xA2 */   0x00, 0x00,
/* 0xA3 */   0x00, 0x00,
/* 0xA4 */   0x00, 0x00,
/* 0xA5 */   0x00, 0x00,
/* 0xA6 */   0x00, 0x00,
/* 0xA7 */   0x00, 0x00,
/* 0xA8 */   0x00, 0x00,
/* 0xA9 */   0x00, 0x00,
/* 0xAA */   0x00, 0x00,
/* 0xAB */   0x00, 0x00,
/* 0xAC */   0x00, 0x00,
/* 0xAD */   0x00, 0x00,
/* 0xAE */   0x00, 0x00,
/* 0xAF */   0x00, 0x00,
/* 0xB0 */   0x00, 0x00,
/* 0xB1 */   0x00, 0x00,
/* 0xB2 */   0x00, 0x00,
/* 0xB3 */   0x00, 0x00,
/* 0xB4 */   0x00, 0x00,
/* 0xB5 */   0x00, 0x00,
/* 0xB6 */   0x00, 0x00,
/* 0xB7 */   0x00, 0x00,
/* 0xB8 */   0x00, 0x00,
/* 0xB9 */   0x00, 0x00,
/* 0xBA */   0x00, 0x00,
/* 0xBB */   0x00, 0x00,
/* 0xBC */   0x00, 0x00,
/* 0xBD */   0x00, 0x00,
/* 0xBE */   0x00, 0x00,
/* 0xBF */   0x00, 0x00,
/* 0xC0 */   0x3D, 0x12,
/* 0xC1 */   0x72, 0x12,
/* 0xC2 */   0xA7, 0x12,
/* 0xC3 */   0xDC, 0x12,
/* 0xC4 */   0x11, 0x13,
/* 0xC5 */   0x4A, 0x13,
/* 0xC6 */   0x7F, 0x13,
/* 0xC7 */   0xCD, 0x13,
/* 0xC8 */   0x02, 0x14,
/* 0xC9 */   0x37, 0x14,
/* 0xCA */   0x6C, 0x14,
/* 0xCB */   0xA1, 0x14,
/* 0xCC */   0xD6, 0x14,
/* 0xCD */   0x24, 0x15,
/* 0xCE */   0x59, 0x15,
/* 0xCF */   0x8E, 0x15,
/* 0xD0 */   0xC3, 0x15,
/* 0xD1 */   0xF8, 0x15,
/* 0xD2 */   0x2D, 0x16,
/* 0xD3 */   0x62, 0x16,
/* 0xD4 */   0x97, 0x16,
/* 0xD5 */   0xE5, 0x16,
/* 0xD6 */   0x1A, 0x17,
/* 0xD7 */   0x57, 0x17,
/* 0xD8 */   0x8C, 0x17,
/* 0xD9 */   0xDA, 0x17,
/* 0xDA */   0x34, 0x18,
/* 0xDB */   0x82, 0x18,
/* 0xDC */   0xB7, 0x18,
/* 0xDD */   0xEC, 0x18,
/* 0xDE */   0x21, 0x19,
/* 0xDF */   0x56, 0x19,
/* 0xE0 */   0x8B, 0x19,
/* 0xE1 */   0xB2, 0x19,
/* 0xE2 */   0xE7, 0x19,
/* 0xE3 */   0x1C, 0x1A,
/* 0xE4 */   0x43, 0x1A,
/* 0xE5 */   0x78, 0x1A,
/* 0xE6 */   0x9F, 0x1A,
/* 0xE7 */   0xC6, 0x1A,
/* 0xE8 */   0xED, 0x1A,
/* 0xE9 */   0x14, 0x1B,
/* 0xEA */   0x49, 0x1B,
/* 0xEB */   0x70, 0x1B,
/* 0xEC */   0x97, 0x1B,
/* 0xED */   0xBE, 0x1B,
/* 0xEE */   0xE5, 0x1B,
/* 0xEF */   0x0C, 0x1C,
/* 0xF0 */   0x33, 0x1C,
/* 0xF1 */   0x68, 0x1C,
/* 0xF2 */   0x8F, 0x1C,
/* 0xF3 */   0xC8, 0x1C,
/* 0xF4 */   0xFD, 0x1C,
/* 0xF5 */   0x57, 0x1D,
/* 0xF6 */   0x7E, 0x1D,
/* 0xF7 */   0xAD, 0x1D,
/* 0xF8 */   0xD4, 0x1D,
/* 0xF9 */   0x0D, 0x1E,
/* 0xFA */   0x52, 0x1E,
/* 0xFB */   0x79, 0x1E,
/* 0xFC */   0xA0, 0x1E,
/* 0xFD */   0xC7, 0x1E,
/* 0xFE */   0xEE, 0x1E,
/* 0xFF */   0x15, 0x1F,

/* Symbol 0x20, offset 512 */
    32, 1, 0,
    0x00, 0x00, 0x00, 0x00, 

/* Symbol 0x21, offset 519 */
    3, 25, 0,
    0xE0, 0xE0, 0xE0, 0xE0, 0xE0, 0xE0, 0xE0, 0xE0, 0xE0, 0xE0, 0xE0, 0xE0, 0xE0, 0xE0, 0xE0, 0xE0, 0xE0, 0xE0, 0xE0, 0x00, 0x00, 0x00, 0x00, 0xE0, 0xE0, 

/* Symbol 0x22, offset 547 */
    6, 5, 0,
    0xFC, 0xDC, 0xDC, 0xDC, 0xD8, 

/* Symbol 0x23, offset 555 */
    17, 25, 0,
    0x03, 0x0E, 0x00, 0x07, 0x0E, 0x00, 0x07, 0x0E, 0x00, 0x07, 0x0C, 0x00,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 0x00, 

/* Symbol 0x24, offset 633 */
    14, 29, 0,
    0x1F, 0xE0, 0x7F, 0xF8, 0x77, 0x38, 0xF7, 0x00, 0xE7, 0x00, 0xE7, 0x00,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 0x00, 

/* Symbol 0x25, offset 694 */
    28, 25, 0,
    0x1F, 0x80, 0x0E, 0x00, 0x3F, 0xC0, 0x1C, 0x00, 0x79, 0xE0, 0x1C, 0x00,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 0x80, 

/* Symbol 0x26, offset 797 */
    17, 25, 0,
    0x0F, 0x80, 0x00, 0x1F, 0xC0, 0x00, 0x3D, 0xE0, 0x00, 0x38, 0xE0, 0x00,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 0x80, 

/* Symbol 0x27, offset 875 */
    3, 7, 0,
    0xE0, 0xE0, 0xC0, 0xC0, 0xC0, 0xC0, 0xC0, 

/* Symbol 0x28, offset 885 */
    5, 27, 0,
    0x70, 0x70, 0x70, 0x70, 0x60, 0xE0, 0xE0, 0xE0, 0xE0, 0xE0, 0xE0, 0xE0, 0xE0, 0xE0, 0xE0, 0xE0, 0xE0, 0xE0, 0xE0, 0x60, 0x60, 0x70, 0x70, 0x70, 0x70, 0x38, 0x30, 

/* Symbol 0x29, offset 915 */
    5, 27, 0,
    0x70, 0x70, 0x70, 0x70, 0x70, 0x38, 0x38, 0x38, 0x38, 0x38, 0x38, 0x38, 0x38, 0x38, 0x38, 0x38, 0x38, 0x38, 0x38, 0x30, 0x70, 0x70, 0x70, 0x70, 0xE0, 0xE0, 0xE0, 

/* Symbol 0x2A, offset 945 */
    9, 9, 0,
    0x36, 0x00, 0x3E, 0x00, 0x3C, 0x00, 0xFF, 0x80, 0xFF, 0x80, 0x1E, 0x00, 0x3E, 0x00, 0x3E, 0x00, 0x36, 0x00, 

/* Symbol 0x2B, offset 966 */
    12, 22, 10,
    0x0E, 0x00, 0x0E, 0x00, 0x0E, 0x00, 0x0E, 0x00, 0x0E, 0x00, 0xFF, 0xF0, 0xFF, 0xF0, 0x0E, 0x00, 0x0E, 0x00, 0x0E, 0x00, 0x0E, 0x00, 0x0E, 0x00, 

/* Symbol 0x2C, offset 993 */
    3, 29, 24,
    0xE0, 0xC0, 0xC0, 0xC0, 0xC0, 

/* Symbol 0x2D, offset 1001 */
    12, 17, 15,
    0xFF, 0xF0, 0xFF, 0xF0, 

/* Symbol 0x2E, offset 1008 */
    3, 25, 23,
    0xE0, 0xE0, 

/* Symbol 0x2F, offset 1013 */
    16, 29, 0,
    0x00, 0x07, 0x00, 0x0E, 0x00, 0x0E, 0x00, 0x0E, 0x00, 0x1C, 0x00, 0x1C,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 0x00, 

/* Symbol 0x30, offset 1074 */
    14, 25, 0,
    0x1F, 0xE0, 0x3F, 0xF0, 0x78, 0x78, 0xF0, 0x3C, 0xE0, 0x1C, 0xE0, 0x1C,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 0xE0, 

/* Symbol 0x31, offset 1127 */
    8, 25, 0,
    0x07, 0x0F, 0x1F, 0x3F, 0x77, 0xE7, 0xE7, 0x07, 0x07, 0x07, 0x07, 0x07, 0x07, 0x07, 0x07, 0x07, 0x07, 0x07, 0x07, 0x07, 0x07, 0x07, 0x07, 0x07, 0x07, 

/* Symbol 0x32, offset 1155 */
    14, 25, 0,
    0x1F, 0xC0, 0x3F, 0xE0, 0x78, 0xF8, 0xF0, 0x38, 0xE0, 0x1C, 0x00, 0x1C,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 0xF8, 

/* Symbol 0x33, offset 1208 */
    12, 25, 0,
    0xFF, 0x00, 0xFF, 0xC0, 0x01, 0xC0, 0x00, 0xE0, 0x00, 0xE0, 0x00, 0xE0,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 0x80, 

/* Symbol 0x34, offset 1261 */
    13, 25, 0,
    0x0C, 0x00, 0x1C, 0x00, 0x1C, 0x00, 0x1C, 0x00, 0x1C, 0x00, 0x38, 0x00,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 0xC0, 

/* Symbol 0x35, offset 1314 */
    12, 25, 0,
    0xFF, 0xF0, 0xFF, 0xF0, 0xE0, 0x00, 0xE0, 0x00, 0xE0, 0x00, 0xE0, 0x00,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 0x80, 

/* Symbol 0x36, offset 1367 */
    14, 25, 0,
    0x01, 0xC0, 0x07, 0xC0, 0x0F, 0x00, 0x1C, 0x00, 0x38, 0x00, 0x38, 0x00,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 0xE0, 

/* Symbol 0x37, offset 1420 */
    13, 25, 0,
    0xFF, 0xF8, 0xFF, 0xF8, 0xE0, 0x38, 0xE0, 0x38, 0xE0, 0x38, 0x00, 0x30,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 0x00, 

/* Symbol 0x38, offset 1473 */
    14, 25, 0,
    0x0F, 0xC0, 0x1F, 0xE0, 0x3C, 0xF0, 0x78, 0x78, 0x70, 0x38, 0x70, 0x38,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 0xE0, 

/* Symbol 0x39, offset 1526 */
    14, 25, 0,
    0x1F, 0xE0, 0x3F, 0xF0, 0x78, 0x78, 0xF0, 0x3C, 0xE0, 0x1C, 0xE0, 0x1C,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 0x00, 

/* Symbol 0x3A, offset 1579 */
    3, 19, 8,
    0xE0, 0xE0, 0x00, 0x00, 0x00, 0x00, 0x00, 0x00, 0x00, 0xE0, 0xE0, 

/* Symbol 0x3B, offset 1593 */
    4, 29, 14,
    0x70, 0x70, 0x00, 0x00, 0x00, 0x00, 0x00, 0x00, 0x00, 0x70, 0x70, 0x70, 0x70, 0xE0, 0x60, 

/* Symbol 0x3C, offset 1611 */
    12, 22, 10,
    0x00, 0x70, 0x01, 0xF0, 0x07, 0xC0, 0x1F, 0x00, 0x3E, 0x00, 0xF8, 0x00, 0xF8, 0x00, 0x3E, 0x00, 0x1F, 0x00, 0x07, 0xC0, 0x01, 0xF0, 0x00, 0x70, 

/* Symbol 0x3D, offset 1638 */
    11, 20, 12,
    0xFF, 0xE0, 0xFF, 0xE0, 0x00, 0x00, 0x00, 0x00, 0x00, 0x00, 0x00, 0x00, 0xFF, 0xE0, 0xFF, 0xE0, 

/* Symbol 0x3E, offset 1657 */
    12, 22, 10,
    0xE0, 0x00, 0xF8, 0x00, 0x3E, 0x00, 0x0F, 0x00, 0x03, 0xC0, 0x00, 0xF0, 0x00, 0xF0, 0x03, 0xC0, 0x0F, 0x00, 0x3E, 0x00, 0xF8, 0x00, 0xE0, 0x00, 

/* Symbol 0x3F, offset 1684 */
    13, 25, 0,
    0x3F, 0xC0, 0x7F, 0xE0, 0xE0, 0xF0, 0x00, 0x78, 0x00, 0x38, 0x00, 0x38,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 0x00, 

/* Symbol 0x40, offset 1737 */
    26, 25, 0,
    0x00, 0x7F, 0x80, 0x00, 0x03, 0xFF, 0xE0, 0x00, 0x07, 0xC0, 0xF8, 0x00,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 0x00, 

/* Symbol 0x41, offset 1840 */
    15, 25, 0,
    0x03, 0x80, 0x03, 0x80, 0x03, 0x80, 0x07, 0xC0, 0x07, 0xC0, 0x07, 0xC0,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 0x0E, 

/* Symbol 0x42, offset 1893 */
    14, 25, 0,
    0xFF, 0xC0, 0xFF, 0xE0, 0xE0, 0xF0, 0xE0, 0x78, 0xE0, 0x38, 0xE0, 0x38,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 0xE0, 

/* Symbol 0x43, offset 1946 */
    12, 25, 0,
    0x1F, 0xE0, 0x3F, 0xF0, 0x78, 0x00, 0xF0, 0x00, 0xE0, 0x00, 0xE0, 0x00,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 0xF0, 

/* Symbol 0x44, offset 1999 */
    14, 25, 0,
    0xFF, 0xE0, 0xFF, 0xF0, 0xE0, 0x78, 0xE0, 0x3C, 0xE0, 0x1C, 0xE0, 0x1C,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 0xE0, 

/* Symbol 0x45, offset 2052 */
    12, 25, 0,
    0xFF, 0xF0, 0xFF, 0xF0, 0xE0, 0x00, 0xE0, 0x00, 0xE0, 0x00, 0xE0, 0x00,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 0xF0, 

/* Symbol 0x46, offset 2105 */
    12, 25, 0,
    0xFF, 0xE0, 0xFF, 0xF0, 0xE0, 0x00, 0xE0, 0x00, 0xE0, 0x00, 0xE0, 0x00,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 0x00, 

/* Symbol 0x47, offset 2158 */
    14, 25, 0,
    0x1F, 0xFC, 0x3F, 0xFC, 0x78, 0x00, 0xF0, 0x00, 0xE0, 0x00, 0xE0, 0x00,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 0xFC, 

/* Symbol 0x48, offset 2211 */
    14, 25, 0,
    0xE0, 0x1C, 0xE0, 0x1C, 0xE0, 0x1C, 0xE0, 0x1C, 0xE0, 0x1C, 0xE0, 0x1C,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 0x1C, 

/* Symbol 0x49, offset 2264 */
    3, 25, 0,
    0xE0, 0xE0, 0xE0, 0xE0, 0xE0, 0xE0, 0xE0, 0xE0, 0xE0, 0xE0, 0xE0, 0xE0, 0xE0, 0xE0, 0xE0, 0xE0, 0xE0, 0xE0, 0xE0, 0xE0, 0xE0, 0xE0, 0xE0, 0xE0, 0xE0, 

/* Symbol 0x4A, offset 2292 */
    10, 25, 0,
    0x01, 0xC0, 0x01, 0xC0, 0x01, 0xC0, 0x01, 0xC0, 0x01, 0xC0, 0x01, 0xC0,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 0x00, 

/* Symbol 0x4B, offset 2345 */
    14, 25, 0,
    0xE0, 0x1C, 0xE0, 0x38, 0xE0, 0x78, 0xE0, 0x70, 0xE0, 0xE0, 0xE1, 0xC0,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 0x1C, 

/* Symbol 0x4C, offset 2398 */
    10, 25, 0,
    0xE0, 0x00, 0xE0, 0x00, 0xE0, 0x00, 0xE0, 0x00, 0xE0, 0x00, 0xE0, 0x00,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 0xC0, 

/* Symbol 0x4D, offset 2451 */
    17, 25, 0,
    0xE0, 0x03, 0x80, 0xE0, 0x03, 0x80, 0xF0, 0x07, 0x80, 0xF8, 0x0F, 0x80,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 0x80, 

/* Symbol 0x4E, offset 2529 */
    14, 25, 0,
    0xE0, 0x1C, 0xE0, 0x1C, 0xF0, 0x1C, 0xF0, 0x1C, 0xF8, 0x1C, 0xF8, 0x1C,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 0x1C, 

/* Symbol 0x4F, offset 2582 */
    14, 25, 0,
    0x1F, 0xE0, 0x3F, 0xF0, 0x78, 0x78, 0xF0, 0x3C, 0xE0, 0x1C, 0xE0, 0x1C,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 0xE0, 

/* Symbol 0x50, offset 2635 */
    14, 25, 0,
    0xFF, 0xE0, 0xFF, 0xF0, 0xE0, 0x78, 0xE0, 0x3C, 0xE0, 0x1C, 0xE0, 0x1C,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 0x00, 

/* Symbol 0x51, offset 2688 */
    15, 25, 0,
    0x1F, 0xE0, 0x3F, 0xF0, 0x78, 0x78, 0xF0, 0x3C, 0xE0, 0x1C, 0xE0, 0x1C,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 0xE6, 

/* Symbol 0x52, offset 2741 */
    14, 25, 0,
    0xFF, 0xE0, 0xFF, 0xF0, 0xE0, 0x78, 0xE0, 0x3C, 0xE0, 0x1C, 0xE0, 0x1C,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 0x1C, 

/* Symbol 0x53, offset 2794 */
    14, 25, 0,
    0x1F, 0xF0, 0x3F, 0xF8, 0x78, 0x1C, 0xF0, 0x00, 0xE0, 0x00, 0xE0, 0x00,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 0xE0, 

/* Symbol 0x54, offset 2847 */
    13, 25, 0,
    0xFF, 0xF8, 0xFF, 0xF8, 0x07, 0x00, 0x07, 0x00, 0x07, 0x00, 0x07, 0x00,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 0x00, 

/* Symbol 0x55, offset 2900 */
    14, 25, 0,
    0xE0, 0x1C, 0xE0, 0x1C, 0xE0, 0x1C, 0xE0, 0x1C, 0xE0, 0x1C, 0xE0, 0x1C,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 0xE0, 

/* Symbol 0x56, offset 2953 */
    15, 25, 0,
    0xE0, 0x0E, 0xE0, 0x0E, 0xE0, 0x0E, 0x60, 0x0C, 0x70, 0x1C, 0x70, 0x1C,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 0x80, 

/* Symbol 0x57, offset 3006 */
    22, 25, 0,
    0xE0, 0x00, 0x0C, 0xE0, 0x00, 0x0C, 0xE0, 0x00, 0x1C, 0xE0, 0x00, 0x1C,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 0xC0, 

/* Symbol 0x58, offset 3084 */
    15, 25, 0,
    0xE0, 0x0E, 0xE0, 0x0E, 0x70, 0x1C, 0x70, 0x1C, 0x38, 0x38, 0x38, 0x38,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 0x0E, 

/* Symbol 0x59, offset 3137 */
    15, 25, 0,
    0xE0, 0x0E, 0xE0, 0x0E, 0x70, 0x1C, 0x70, 0x1C, 0x38, 0x38, 0x38, 0x38,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 0x80, 

/* Symbol 0x5A, offset 3190 */
    14, 25, 0,
    0xFF, 0xFC, 0xFF, 0xF8, 0x00, 0x38, 0x00, 0x70, 0x00, 0x70, 0x00, 0x60,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 0xF8, 

/* Symbol 0x5B, offset 3243 */
    5, 27, 0,
    0xE0, 0xE0, 0xE0, 0xE0, 0xE0, 0xE0, 0xE0, 0xE0, 0xE0, 0xE0, 0xE0, 0xE0, 0xE0, 0xE0, 0xE0, 0xE0, 0xE0, 0xE0, 0xE0, 0xE0, 0xE0, 0xE0, 0xE0, 0xE0, 0xE0, 0xF8, 0xF8, 

/* Symbol 0x5C, offset 3273 */
    16, 29, 0,
    0xE0, 0x00, 0x70, 0x00, 0x70, 0x00, 0x38, 0x00, 0x38, 0x00, 0x38, 0x00,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 0x03, 

/* Symbol 0x5D, offset 3334 */
    5, 27, 0,
    0x38, 0x38, 0x38, 0x38, 0x38, 0x38, 0x38, 0x38, 0x38, 0x38, 0x38, 0x38, 0x38, 0x38, 0x38, 0x38, 0x38, 0x38, 0x38, 0x38, 0x38, 0x38, 0x38, 0x38, 0x38, 0xF8, 0xF8, 

/* Symbol 0x5E, offset 3364 */
    32, 1, 0,
    0x00, 0x00, 0x00, 0x00, 

/* Symbol 0x5F, offset 3371 */
    13, 29, 27,
    0xFF, 0xF8, 0xFF, 0xF8, 

/* Symbol 0x60, offset 3378 */
    22, 25, 0,
    0xFF, 0xFF, 0xFC, 0xFF, 0xFF, 0xFC, 0xC0, 0x00, 0x1C, 0xC0, 0x00, 0x1C,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 0xFC, 

/* Symbol 0x61, offset 3456 */
    13, 25, 7,
    0x7F, 0xE0, 0xFF, 0xE0, 0xE0, 0xE0, 0xC0, 0xE0, 0xC0, 0xE0, 0xC0, 0xE0,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 0xB8, 

/* Symbol 0x62, offset 3495 */
    12, 25, 0,
    0xE0, 0x00, 0xE0, 0x00, 0xE0, 0x00, 0xE0, 0x00, 0xE0, 0x00, 0xE0, 0x00,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 0xC0, 

/* Symbol 0x63, offset 3548 */
    12, 25, 7,
    0x3F, 0xE0, 0x7F, 0xF0, 0xF0, 0x00, 0xE0, 0x00, 0xE0, 0x00, 0xE0, 0x00,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 0xF0, 

/* Symbol 0x64, offset 3587 */
    12, 25, 0,
    0x00, 0x70, 0x00, 0x70, 0x00, 0x70, 0x00, 0x70, 0x00, 0x70, 0x00, 0x70,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 0xF0, 

/* Symbol 0x65, offset 3640 */
    12, 25, 7,
    0x3F, 0xC0, 0x7F, 0xE0, 0xF0, 0xF0, 0xE0, 0x70, 0xE0, 0x70, 0xE0, 0x70,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 0xF0, 

/* Symbol 0x66, offset 3679 */
    8, 25, 0,
    0x0F, 0x1F, 0x38, 0x38, 0x38, 0x38, 0x38, 0xFF, 0xFF, 0x38, 0x38, 0x38, 0x38, 0x38, 0x38, 0x38, 0x38, 0x38, 0x38, 0x38, 0x38, 0x38, 0x38, 0x38, 0x38, 

/* Symbol 0x67, offset 3707 */
    12, 32, 7,
    0x3F, 0xF0, 0x7F, 0xF0, 0xF0, 0x70, 0xE0, 0x70, 0xE0, 0x70, 0xE0, 0x70,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 0xC0, 

/* Symbol 0x68, offset 3760 */
    12, 25, 0,
    0xE0, 0x00, 0xE0, 0x00, 0xE0, 0x00, 0xE0, 0x00, 0xE0, 0x00, 0xE0, 0x00,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 0x70, 

/* Symbol 0x69, offset 3813 */
    3, 25, 0,
    0xE0, 0xE0, 0x00, 0x00, 0x00, 0x00, 0x00, 0xE0, 0xE0, 0xE0, 0xE0, 0xE0, 0xE0, 0xE0, 0xE0, 0xE0, 0xE0, 0xE0, 0xE0, 0xE0, 0xE0, 0xE0, 0xE0, 0xE0, 0xE0, 

/* Symbol 0x6A, offset 3841 */
    3, 32, 0,
    0xE0, 0xC0, 0x00, 0x00, 0x00, 0x00, 0x00, 0x00, 0xE0, 0xE0, 0xE0, 0xE0, 0xE0, 0xE0, 0xE0, 0xE0, 0xE0, 0xE0, 0xE0, 0xE0, 0xE0, 0xE0, 0xE0, 0xE0, 0xE0, 0xE0, 0xE0, 0xE0, 0xE0, 0xE0, 0xE0, 0xC0, 

/* Symbol 0x6B, offset 3876 */
    12, 25, 0,
    0xE0, 0x00, 0xE0, 0x00, 0xE0, 0x00, 0xE0, 0x00, 0xE0, 0x00, 0xE0, 0x00,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 0x70, 

/* Symbol 0x6C, offset 3929 */
    6, 25, 0,
    0xE0, 0xE0, 0xE0, 0xE0, 0xE0, 0xE0, 0xE0, 0xE0, 0xE0, 0xE0, 0xE0, 0xE0, 0xE0, 0xE0, 0xE0, 0xE0, 0xE0, 0xE0, 0xE0, 0xE0, 0xE0, 0xE0, 0xE0, 0x7C, 0x3C, 

/* Symbol 0x6D, offset 3957 */
    17, 25, 7,
    0xFF, 0xFE, 0x00, 0xFF, 0xFF, 0x00, 0xE1, 0xC3, 0x80, 0xE1, 0xC3, 0x80,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 0x80, 

/* Symbol 0x6E, offset 4014 */
    12, 25, 7,
    0xFF, 0xC0, 0xFF, 0xE0, 0xE0, 0xF0, 0xE0, 0x70, 0xE0, 0x70, 0xE0, 0x70,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 0x70, 

/* Symbol 0x6F, offset 4053 */
    12, 25, 7,
    0x3F, 0xC0, 0x7F, 0xE0, 0xF0, 0xF0, 0xE0, 0x70, 0xE0, 0x70, 0xE0, 0x70,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 0xC0, 

/* Symbol 0x70, offset 4092 */
    12, 32, 7,
    0xFF, 0xC0, 0xFF, 0xE0, 0xE0, 0xF0, 0xE0, 0x70, 0xE0, 0x70, 0xE0, 0x70,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 0x00, 

/* Symbol 0x71, offset 4145 */
    12, 32, 7,
    0x3F, 0xF0, 0x7F, 0xF0, 0xF0, 0x70, 0xE0, 0x70, 0xE0, 0x70, 0xE0, 0x70,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 0x70, 

/* Symbol 0x72, offset 4198 */
    10, 25, 7,
    0xFF, 0x00, 0xFF, 0x80, 0xE1, 0xC0, 0xE0, 0x00, 0xE0, 0x00, 0xE0, 0x00,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 0x00, 

/* Symbol 0x73, offset 4237 */
    12, 25, 7,
    0x3F, 0xC0, 0x7F, 0xE0, 0xF0, 0xF0, 0xE0, 0x00, 0xE0, 0x00, 0xF0, 0x00,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 0xC0, 

/* Symbol 0x74, offset 4276 */
    8, 25, 0,
    0x38, 0x38, 0x38, 0x38, 0x38, 0x38, 0x38, 0xFF, 0xFF, 0x38, 0x38, 0x38, 0x38, 0x38, 0x38, 0x38, 0x38, 0x38, 0x38, 0x38, 0x38, 0x38, 0x38, 0x38, 0x38, 

/* Symbol 0x75, offset 4304 */
    12, 25, 7,
    0xE0, 0x70, 0xE0, 0x70, 0xE0, 0x70, 0xE0, 0x70, 0xE0, 0x70, 0xE0, 0x70,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 0xF0, 

/* Symbol 0x76, offset 4343 */
    12, 25, 7,
    0xC0, 0x70, 0xE0, 0x70, 0xE0, 0xE0, 0x60, 0xE0, 0x70, 0xE0, 0x70, 0xC0,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 0x00, 

/* Symbol 0x77, offset 4382 */
    19, 25, 7,
    0xC0, 0x00, 0xE0, 0xE0, 0x00, 0xE0, 0xE0, 0x00, 0xE0, 0xE0, 0xE1, 0xC0,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 0x00, 

/* Symbol 0x78, offset 4439 */
    12, 25, 7,
    0xE0, 0x70, 0xE0, 0xE0, 0x70, 0xE0, 0x71, 0xC0, 0x39, 0xC0, 0x3B, 0x80,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 0x70, 

/* Symbol 0x79, offset 4478 */
    12, 32, 7,
    0xC0, 0x70, 0xE0, 0x60, 0xE0, 0xE0, 0xE0, 0xE0, 0x70, 0xE0, 0x70, 0xC0,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 0x00, 

/* Symbol 0x7A, offset 4531 */
    11, 25, 7,
    0xFF, 0xE0, 0xFF, 0xC0, 0x01, 0xC0, 0x03, 0x80, 0x03, 0x80, 0x07, 0x00,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 0xE0, 

/* Symbol 0x7B, offset 4570 */
    6, 27, 0,
    0x38, 0x38, 0x38, 0x38, 0x38, 0x38, 0x38, 0x38, 0x38, 0x38, 0x38, 0xF0, 0xF0, 0x38, 0x38, 0x38, 0x38, 0x38, 0x38, 0x38, 0x38, 0x38, 0x38, 0x38, 0x38, 0x3C, 0x1C, 

/* Symbol 0x7C, offset 4600 */
    3, 25, 0,
    0xE0, 0xE0, 0xE0, 0xE0, 0xE0, 0xE0, 0xE0, 0xE0, 0xE0, 0xE0, 0xE0, 0xE0, 0xE0, 0xE0, 0xE0, 0xE0, 0xE0, 0xE0, 0xE0, 0xE0, 0xE0, 0xE0, 0xE0, 0xE0, 0xE0, 

/* Symbol 0x7D, offset 4628 */
    6, 27, 0,
    0x70, 0x70, 0x70, 0x70, 0x70, 0x70, 0x70, 0x70, 0x70, 0x70, 0x70, 0x3C, 0x3C, 0x70, 0x70, 0x70, 0x70, 0x70, 0x70, 0x70, 0x70, 0x70, 0x70, 0x70, 0x70, 0xF0, 0xE0, 

/* Symbol 0x7E, offset 4658 */
    13, 18, 14,
    0x7E, 0x00, 0xFF, 0x18, 0xE7, 0xF8, 0x01, 0xF0, 

/* Symbol 0xC0, offset 4669 */
    15, 25, 0,
    0x03, 0x80, 0x03, 0x80, 0x03, 0x80, 0x07, 0xC0, 0x07, 0xC0, 0x07, 0xC0,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 0x0E, 

/* Symbol 0xC1, offset 4722 */
    14, 25, 0,
    0xFF, 0xF8, 0xFF, 0xF8, 0xE0, 0x00, 0xE0, 0x00, 0xE0, 0x00, 0xE0, 0x00,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 0xE0, 

/* Symbol 0xC2, offset 4775 */
    14, 25, 0,
    0xFF, 0xC0, 0xFF, 0xE0, 0xE0, 0xF0, 0xE0, 0x78, 0xE0, 0x38, 0xE0, 0x38,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 0xE0, 

/* Symbol 0xC3, offset 4828 */
    12, 25, 0,
    0xFF, 0xE0, 0xFF, 0xF0, 0xE0, 0x00, 0xE0, 0x00, 0xE0, 0x00, 0xE0, 0x00,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 0x00, 

/* Symbol 0xC4, offset 4881 */
    15, 27, 0,
    0x0F, 0xFC, 0x0F, 0xFC, 0x0C, 0x1C, 0x1C, 0x1C, 0x1C, 0x1C, 0x1C, 0x1C,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 0x0E, 

/* Symbol 0xC5, offset 4938 */
    12, 25, 0,
    0xFF, 0xF0, 0xFF, 0xF0, 0xE0, 0x00, 0xE0, 0x00, 0xE0, 0x00, 0xE0, 0x00,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 0xF0, 

/* Symbol 0xC6, offset 4991 */
    17, 25, 0,
    0xE1, 0xC3, 0x80, 0xE1, 0xC3, 0x80, 0x71, 0xC7, 0x00, 0x71, 0xC7, 0x00,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 0x80, 

/* Symbol 0xC7, offset 5069 */
    14, 25, 0,
    0x0F, 0xE0, 0x3F, 0xF0, 0x78, 0x78, 0x70, 0x3C, 0x60, 0x1C, 0x00, 0x1C,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 0xE0, 

/* Symbol 0xC8, offset 5122 */
    14, 25, 0,
    0xE0, 0x1C, 0xE0, 0x1C, 0xE0, 0x3C, 0xE0, 0x3C, 0xE0, 0x7C, 0xE0, 0x7C,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 0x1C, 

/* Symbol 0xC9, offset 5175 */
    14, 25, 0,
    0xE0, 0x1C, 0xE0, 0x1C, 0xE0, 0x3C, 0xE0, 0x3C, 0xE0, 0x7C, 0xE0, 0x7C,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 0x1C, 

/* Symbol 0xCA, offset 5228 */
    14, 25, 0,
    0xE0, 0x1C, 0xE0, 0x38, 0xE0, 0x78, 0xE0, 0x70, 0xE0, 0xE0, 0xE1, 0xC0,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 0x1C, 

/* Symbol 0xCB, offset 5281 */
    15, 25, 0,
    0x01, 0xFE, 0x01, 0xFE, 0x03, 0x8E, 0x03, 0x8E, 0x03, 0x8E, 0x07, 0x0E,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 0x0E, 

/* Symbol 0xCC, offset 5334 */
    17, 25, 0,
    0xE0, 0x03, 0x80, 0xE0, 0x03, 0x80, 0xF0, 0x07, 0x80, 0xF8, 0x0F, 0x80,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 0x80, 

/* Symbol 0xCD, offset 5412 */
    14, 25, 0,
    0xE0, 0x1C, 0xE0, 0x1C, 0xE0, 0x1C, 0xE0, 0x1C, 0xE0, 0x1C, 0xE0, 0x1C,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 0x1C, 

/* Symbol 0xCE, offset 5465 */
    14, 25, 0,
    0x1F, 0xE0, 0x3F, 0xF0, 0x78, 0x78, 0xF0, 0x3C, 0xE0, 0x1C, 0xE0, 0x1C,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 0xE0, 

/* Symbol 0xCF, offset 5518 */
    14, 25, 0,
    0xFF, 0xFC, 0xFF, 0xFC, 0xE0, 0x1C, 0xE0, 0x1C, 0xE0, 0x1C, 0xE0, 0x1C,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 0x1C, 

/* Symbol 0xD0, offset 5571 */
    14, 25, 0,
    0xFF, 0xE0, 0xFF, 0xF0, 0xE0, 0x78, 0xE0, 0x3C, 0xE0, 0x1C, 0xE0, 0x1C,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 0x00, 

/* Symbol 0xD1, offset 5624 */
    12, 25, 0,
    0x1F, 0xE0, 0x3F, 0xF0, 0x78, 0x00, 0xF0, 0x00, 0xE0, 0x00, 0xE0, 0x00,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 0xF0, 

/* Symbol 0xD2, offset 5677 */
    13, 25, 0,
    0xFF, 0xF8, 0xFF, 0xF8, 0x07, 0x00, 0x07, 0x00, 0x07, 0x00, 0x07, 0x00,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 0x00, 

/* Symbol 0xD3, offset 5730 */
    14, 25, 0,
    0xE0, 0x1C, 0xE0, 0x1C, 0xE0, 0x1C, 0xE0, 0x1C, 0xE0, 0x1C, 0xE0, 0x1C,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 0xE0, 

/* Symbol 0xD4, offset 5783 */
    21, 25, 0,
    0x00, 0x70, 0x00, 0x00, 0x70, 0x00, 0x00, 0x70, 0x00, 0x07, 0xFF, 0x00,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 0x00, 

/* Symbol 0xD5, offset 5861 */
    15, 25, 0,
    0xE0, 0x0E, 0xE0, 0x0E, 0x70, 0x1C, 0x70, 0x1C, 0x38, 0x38, 0x38, 0x38,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 0x0E, 

/* Symbol 0xD6, offset 5914 */
    15, 29, 0,
    0xE0, 0x1C, 0xE0, 0x1C, 0xE0, 0x1C, 0xE0, 0x1C, 0xE0, 0x1C, 0xE0, 0x1C,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 0x0E, 

/* Symbol 0xD7, offset 5975 */
    14, 25, 0,
    0xE0, 0x1C, 0xE0, 0x1C, 0xE0, 0x1C, 0xE0, 0x1C, 0xE0, 0x1C, 0xE0, 0x1C,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 0x1C, 

/* Symbol 0xD8, offset 6028 */
    17, 25, 0,
    0xE1, 0xC3, 0x80, 0xE1, 0xC3, 0x80, 0xE1, 0xC3, 0x80, 0xE1, 0xC3, 0x80,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 0x80, 

/* Symbol 0xD9, offset 6106 */
    19, 29, 0,
    0xE1, 0xC3, 0x80, 0xE1, 0xC3, 0x80, 0xE1, 0xC3, 0x80, 0xE1, 0xC3, 0x80,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 0xE0, 

/* Symbol 0xDA, offset 6196 */
    17, 25, 0,
    0xFE, 0x00, 0x00, 0xFE, 0x00, 0x00, 0x0E, 0x00, 0x00, 0x0E, 0x00, 0x00,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 0x00, 

/* Symbol 0xDB, offset 6274 */
    15, 25, 0,
    0xE0, 0x0E, 0xE0, 0x0E, 0xE0, 0x0E, 0xE0, 0x0E, 0xE0, 0x0E, 0xE0, 0x0E,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 0x8E, 

/* Symbol 0xDC, offset 6327 */
    14, 25, 0,
    0xE0, 0x00, 0xE0, 0x00, 0xE0, 0x00, 0xE0, 0x00, 0xE0, 0x00, 0xE0, 0x00,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 0xE0, 

/* Symbol 0xDD, offset 6380 */
    13, 25, 0,
    0xFF, 0xC0, 0xFF, 0xE0, 0x00, 0xF0, 0x00, 0x78, 0x00, 0x38, 0x00, 0x38,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 0xC0, 

/* Symbol 0xDE, offset 6433 */
    15, 25, 0,
    0xE1, 0xF0, 0xE7, 0xFC, 0xE7, 0x1C, 0xEE, 0x0E, 0xEE, 0x0E, 0xEE, 0x0E,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 0xF0, 

/* Symbol 0xDF, offset 6486 */
    14, 25, 0,
    0x1F, 0xFC, 0x3F, 0xFC, 0x78, 0x1C, 0xF0, 0x1C, 0xE0, 0x1C, 0xE0, 0x1C,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 0x1C, 

/* Symbol 0xE0, offset 6539 */
    14, 25, 7,
    0x3F, 0xF0, 0x7F, 0xF0, 0xF0, 0x70, 0xE0, 0x70, 0xE0, 0x70, 0xE0, 0x70,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 0xDC, 

/* Symbol 0xE1, offset 6578 */
    11, 25, 0,
    0xFF, 0xE0, 0xFF, 0xE0, 0xF0, 0x00, 0x78, 0x00, 0x1C, 0x00, 0x0E, 0x00,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 0x80, 

/* Symbol 0xE2, offset 6631 */
    12, 25, 0,
    0x3C, 0x00, 0x7E, 0x00, 0xE7, 0x00, 0xE7, 0x00, 0xE7, 0x00, 0xEE, 0x00,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 0xC0, 

/* Symbol 0xE3, offset 6684 */
    12, 25, 7,
    0x3F, 0xC0, 0x7F, 0xE0, 0xE0, 0xF0, 0x00, 0x70, 0x00, 0x70, 0x00, 0xE0,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 0xC0, 

/* Symbol 0xE4, offset 6723 */
    12, 25, 0,
    0xFF, 0xC0, 0xFF, 0xE0, 0x00, 0x70, 0x00, 0x70, 0x00, 0x70, 0x00, 0x70,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 0xC0, 

/* Symbol 0xE5, offset 6776 */
    12, 25, 7,
    0x3F, 0xC0, 0x7F, 0xE0, 0xF0, 0xF0, 0xE0, 0x70, 0xE0, 0x70, 0xE0, 0x70,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 0xF0, 

/* Symbol 0xE6, offset 6815 */
    15, 25, 7,
    0xE3, 0x8E, 0xE3, 0x8E, 0x73, 0x9C, 0x7B, 0x9C, 0x3B, 0xB8, 0x1F, 0xF0,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 0x8E, 

/* Symbol 0xE7, offset 6854 */
    10, 25, 7,
    0x3F, 0x00, 0xFF, 0x80, 0xE3, 0xC0, 0xC1, 0xC0, 0x01, 0xC0, 0x01, 0xC0,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 0x00, 

/* Symbol 0xE8, offset 6893 */
    12, 25, 7,
    0xE0, 0x70, 0xE0, 0x70, 0xE0, 0x70, 0xE0, 0x70, 0xE0, 0x70, 0xE0, 0x70,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 0xF0, 

/* Symbol 0xE9, offset 6932 */
    12, 25, 0,
    0x1F, 0x80, 0x1F, 0x80, 0x00, 0x00, 0x00, 0x00, 0x00, 0x00, 0x00, 0x00,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 0xF0, 

/* Symbol 0xEA, offset 6985 */
    12, 25, 7,
    0xE0, 0x70, 0xE0, 0xF0, 0xE1, 0xE0, 0xE3, 0xC0, 0xE3, 0x80, 0xE7, 0x00,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 0x70, 

/* Symbol 0xEB, offset 7024 */
    12, 25, 7,
    0x0F, 0xF0, 0x1F, 0xF0, 0x1C, 0x70, 0x1C, 0x70, 0x1C, 0x70, 0x38, 0x70,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 0x70, 

/* Symbol 0xEC, offset 7063 */
    14, 25, 7,
    0xE0, 0x1C, 0xF0, 0x1C, 0xF0, 0x3C, 0xF8, 0x7C, 0xFC, 0xFC, 0xFC, 0xFC,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 0x1C, 

/* Symbol 0xED, offset 7102 */
    12, 25, 7,
    0xE0, 0x70, 0xE0, 0x70, 0xE0, 0x70, 0xE0, 0x70, 0xE0, 0x70, 0xE0, 0x70,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 0x70, 

/* Symbol 0xEE, offset 7141 */
    12, 25, 7,
    0x3F, 0xC0, 0x7F, 0xE0, 0xF0, 0xF0, 0xE0, 0x70, 0xE0, 0x70, 0xE0, 0x70,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 0xC0, 

/* Symbol 0xEF, offset 7180 */
    12, 25, 7,
    0xFF, 0xC0, 0xFF, 0xE0, 0xE0, 0xF0, 0xE0, 0x70, 0xE0, 0x70, 0xE0, 0x70,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 0x70, 

/* Symbol 0xF0, offset 7219 */
    12, 32, 7,
    0xFF, 0xC0, 0xFF, 0xE0, 0xE0, 0xF0, 0xE0, 0x70, 0xE0, 0x70, 0xE0, 0x70,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 0x00, 

/* Symbol 0xF1, offset 7272 */
    12, 25, 7,
    0x3F, 0xE0, 0x7F, 0xF0, 0xF0, 0x00, 0xE0, 0x00, 0xE0, 0x00, 0xE0, 0x00,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 0xF0, 

/* Symbol 0xF2, offset 7311 */
    17, 25, 7,
    0xFF, 0xFE, 0x00, 0xFF, 0xFF, 0x00, 0xE1, 0xC3, 0x80, 0xE1, 0xC3, 0x80,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 0x80, 

/* Symbol 0xF3, offset 7368 */
    12, 32, 7,
    0xE0, 0x70, 0xE0, 0x70, 0xE0, 0x70, 0xE0, 0x70, 0xE0, 0x70, 0xE0, 0x70,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 0xC0, 

/* Symbol 0xF4, offset 7421 */
    17, 32, 3,
    0x01, 0xC0, 0x00, 0x01, 0xC0, 0x00, 0x01, 0xC0, 0x00, 0x01, 0xC0, 0x00,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 0x00, 

/* Symbol 0xF5, offset 7511 */
    12, 25, 7,
    0xE0, 0x70, 0xE0, 0xE0, 0x70, 0xE0, 0x71, 0xC0, 0x39, 0xC0, 0x3B, 0x80,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 0x70, 

/* Symbol 0xF6, offset 7550 */
    14, 29, 7,
    0xE0, 0x70, 0xE0, 0x70, 0xE0, 0x70, 0xE0, 0x70, 0xE0, 0x70, 0xE0, 0x70,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 0x1C, 

/* Symbol 0xF7, offset 7597 */
    12, 25, 7,
    0xE0, 0x70, 0xE0, 0x70, 0xE0, 0x70, 0xE0, 0x70, 0xE0, 0x70, 0xE0, 0x70,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 0x70, 

/* Symbol 0xF8, offset 7636 */
    17, 25, 7,
    0xE1, 0xC3, 0x80, 0xE1, 0xC3, 0x80, 0xE1, 0xC3, 0x80, 0xE1, 0xC3, 0x80,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 0x80, 

/* Symbol 0xF9, offset 7693 */
    19, 29, 7,
    0xE1, 0xC3, 0x80, 0xE1, 0xC3, 0x80, 0xE1, 0xC3, 0x80, 0xE1, 0xC3, 0x80,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 0xE0, 

/* Symbol 0xFA, offset 7762 */
    15, 25, 7,
    0xFE, 0x00, 0xFE, 0x00, 0x0E, 0x00, 0x0E, 0x00, 0x0E, 0x00, 0x0E, 0x00,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 0xF8, 

/* Symbol 0xFB, offset 7801 */
    14, 25, 7,
    0xE0, 0x1C, 0xE0, 0x1C, 0xE0, 0x1C, 0xE0, 0x1C, 0xE0, 0x1C, 0xE0, 0x1C,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 0x1C, 

/* Symbol 0xFC, offset 7840 */
    12, 25, 7,
    0xE0, 0x00, 0xE0, 0x00, 0xE0, 0x00, 0xE0, 0x00, 0xE0, 0x00, 0xE0, 0x00,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 0xC0, 

/* Symbol 0xFD, offset 7879 */
    12, 25, 7,
    0xFF, 0xC0, 0xFF, 0xE0, 0x00, 0xF0, 0x00, 0x70, 0x00, 0x70, 0x00, 0x70,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 0xC0, 

/* Symbol 0xFE, offset 7918 */
    14, 25, 7,
    0xE3, 0xF0, 0xE7, 0xF8, 0xEE, 0x1C, 0xEE, 0x1C, 0xEE, 0x1C, 0xEE, 0x1C,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 0xF0, 

/* Symbol 0xFF, offset 7957 */
    12, 25, 7,
    0x3F, 0xF0, 0x7F, 0xF0, 0xF0, 0x70, 0xE0, 0x70, 0xE0, 0x70, 0xE0, 0x70,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 0x70
};
