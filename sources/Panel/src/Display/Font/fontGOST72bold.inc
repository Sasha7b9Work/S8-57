const unsigned char fontGOST72bold[6461] =
{
/* 0x00 */   0x00, 0x00,
/* 0x01 */   0x00, 0x00,
/* 0x02 */   0x00, 0x00,
/* 0x03 */   0x00, 0x00,
/* 0x04 */   0x00, 0x00,
/* 0x05 */   0x00, 0x00,
/* 0x06 */   0x00, 0x00,
/* 0x07 */   0x00, 0x00,
/* 0x08 */   0x00, 0x00,
/* 0x09 */   0x00, 0x00,
/* 0x0A */   0x00, 0x00,
/* 0x0B */   0x00, 0x00,
/* 0x0C */   0x00, 0x00,
/* 0x0D */   0x00, 0x00,
/* 0x0E */   0x00, 0x00,
/* 0x0F */   0x00, 0x00,
/* 0x10 */   0x00, 0x00,
/* 0x11 */   0x00, 0x00,
/* 0x12 */   0x00, 0x00,
/* 0x13 */   0x00, 0x00,
/* 0x14 */   0x00, 0x00,
/* 0x15 */   0x00, 0x00,
/* 0x16 */   0x00, 0x00,
/* 0x17 */   0x00, 0x00,
/* 0x18 */   0x00, 0x00,
/* 0x19 */   0x00, 0x00,
/* 0x1A */   0x00, 0x00,
/* 0x1B */   0x00, 0x00,
/* 0x1C */   0x00, 0x00,
/* 0x1D */   0x00, 0x00,
/* 0x1E */   0x00, 0x00,
/* 0x1F */   0x00, 0x00,
/* 0x20 */   0x00, 0x02,
/* 0x21 */   0x00, 0x00,
/* 0x22 */   0x00, 0x00,
/* 0x23 */   0x00, 0x00,
/* 0x24 */   0x00, 0x00,
/* 0x25 */   0x00, 0x00,
/* 0x26 */   0x00, 0x00,
/* 0x27 */   0x00, 0x00,
/* 0x28 */   0x00, 0x00,
/* 0x29 */   0x00, 0x00,
/* 0x2A */   0x00, 0x00,
/* 0x2B */   0x09, 0x02,
/* 0x2C */   0x80, 0x02,
/* 0x2D */   0x8B, 0x02,
/* 0x2E */   0xAC, 0x02,
/* 0x2F */   0x00, 0x00,
/* 0x30 */   0xB5, 0x02,
/* 0x31 */   0x02, 0x04,
/* 0x32 */   0xCB, 0x04,
/* 0x33 */   0x18, 0x06,
/* 0x34 */   0x23, 0x07,
/* 0x35 */   0x70, 0x08,
/* 0x36 */   0x7B, 0x09,
/* 0x37 */   0xC8, 0x0A,
/* 0x38 */   0x15, 0x0C,
/* 0x39 */   0x62, 0x0D,
/* 0x3A */   0xAF, 0x0E,
/* 0x3B */   0x00, 0x00,
/* 0x3C */   0x00, 0x00,
/* 0x3D */   0xCF, 0x0E,
/* 0x3E */   0x00, 0x00,
/* 0x3F */   0x00, 0x00,
/* 0x40 */   0x00, 0x00,
/* 0x41 */   0x1E, 0x0F,
/* 0x42 */   0x00, 0x00,
/* 0x43 */   0x00, 0x00,
/* 0x44 */   0x00, 0x00,
/* 0x45 */   0x00, 0x00,
/* 0x46 */   0x00, 0x00,
/* 0x47 */   0x00, 0x00,
/* 0x48 */   0x00, 0x00,
/* 0x49 */   0x00, 0x00,
/* 0x4A */   0x00, 0x00,
/* 0x4B */   0x00, 0x00,
/* 0x4C */   0x6B, 0x10,
/* 0x4D */   0x76, 0x11,
/* 0x4E */   0x00, 0x00,
/* 0x4F */   0x05, 0x13,
/* 0x50 */   0x00, 0x00,
/* 0x51 */   0x00, 0x00,
/* 0x52 */   0x00, 0x00,
/* 0x53 */   0x00, 0x00,
/* 0x54 */   0x00, 0x00,
/* 0x55 */   0x52, 0x14,
/* 0x56 */   0x9F, 0x15,
/* 0x57 */   0x00, 0x00,
/* 0x58 */   0x00, 0x00,
/* 0x59 */   0x00, 0x00,
/* 0x5A */   0x00, 0x00,
/* 0x5B */   0x00, 0x00,
/* 0x5C */   0x00, 0x00,
/* 0x5D */   0x00, 0x00,
/* 0x5E */   0x00, 0x00,
/* 0x5F */   0x00, 0x00,
/* 0x60 */   0x00, 0x00,
/* 0x61 */   0x00, 0x00,
/* 0x62 */   0x00, 0x00,
/* 0x63 */   0x00, 0x00,
/* 0x64 */   0x00, 0x00,
/* 0x65 */   0x00, 0x00,
/* 0x66 */   0x00, 0x00,
/* 0x67 */   0x00, 0x00,
/* 0x68 */   0x00, 0x00,
/* 0x69 */   0x00, 0x00,
/* 0x6A */   0x00, 0x00,
/* 0x6B */   0xEC, 0x16,
/* 0x6C */   0xF7, 0x17,
/* 0x6D */   0x00, 0x00,
/* 0x6E */   0x00, 0x00,
/* 0x6F */   0x7E, 0x18,
/* 0x70 */   0x00, 0x00,
/* 0x71 */   0x00, 0x00,
/* 0x72 */   0x00, 0x00,
/* 0x73 */   0x00, 0x00,
/* 0x74 */   0x00, 0x00,
/* 0x75 */   0x00, 0x00,
/* 0x76 */   0x00, 0x00,
/* 0x77 */   0x00, 0x00,
/* 0x78 */   0x00, 0x00,
/* 0x79 */   0x00, 0x00,
/* 0x7A */   0x00, 0x00,
/* 0x7B */   0x00, 0x00,
/* 0x7C */   0x00, 0x00,
/* 0x7D */   0x00, 0x00,
/* 0x7E */   0x00, 0x00,
/* 0x7F */   0x00, 0x00,
/* 0x80 */   0x00, 0x00,
/* 0x81 */   0x00, 0x00,
/* 0x82 */   0x00, 0x00,
/* 0x83 */   0x00, 0x00,
/* 0x84 */   0x00, 0x00,
/* 0x85 */   0x00, 0x00,
/* 0x86 */   0x00, 0x00,
/* 0x87 */   0x00, 0x00,
/* 0x88 */   0x00, 0x00,
/* 0x89 */   0x00, 0x00,
/* 0x8A */   0x00, 0x00,
/* 0x8B */   0x00, 0x00,
/* 0x8C */   0x00, 0x00,
/* 0x8D */   0x00, 0x00,
/* 0x8E */   0x00, 0x00,
/* 0x8F */   0x00, 0x00,
/* 0x90 */   0x00, 0x00,
/* 0x91 */   0x00, 0x00,
/* 0x92 */   0x00, 0x00,
/* 0x93 */   0x00, 0x00,
/* 0x94 */   0x00, 0x00,
/* 0x95 */   0x00, 0x00,
/* 0x96 */   0x00, 0x00,
/* 0x97 */   0x00, 0x00,
/* 0x98 */   0x00, 0x00,
/* 0x99 */   0x00, 0x00,
/* 0x9A */   0x00, 0x00,
/* 0x9B */   0x00, 0x00,
/* 0x9C */   0x00, 0x00,
/* 0x9D */   0x00, 0x00,
/* 0x9E */   0x00, 0x00,
/* 0x9F */   0x00, 0x00,
/* 0xA0 */   0x00, 0x00,
/* 0xA1 */   0x00, 0x00,
/* 0xA2 */   0x00, 0x00,
/* 0xA3 */   0x00, 0x00,
/* 0xA4 */   0x00, 0x00,
/* 0xA5 */   0x00, 0x00,
/* 0xA6 */   0x00, 0x00,
/* 0xA7 */   0x00, 0x00,
/* 0xA8 */   0x00, 0x00,
/* 0xA9 */   0x00, 0x00,
/* 0xAA */   0x00, 0x00,
/* 0xAB */   0x00, 0x00,
/* 0xAC */   0x00, 0x00,
/* 0xAD */   0x00, 0x00,
/* 0xAE */   0x00, 0x00,
/* 0xAF */   0x00, 0x00,
/* 0xB0 */   0x00, 0x00,
/* 0xB1 */   0x00, 0x00,
/* 0xB2 */   0x00, 0x00,
/* 0xB3 */   0x00, 0x00,
/* 0xB4 */   0x00, 0x00,
/* 0xB5 */   0x00, 0x00,
/* 0xB6 */   0x00, 0x00,
/* 0xB7 */   0x00, 0x00,
/* 0xB8 */   0x00, 0x00,
/* 0xB9 */   0x00, 0x00,
/* 0xBA */   0x00, 0x00,
/* 0xBB */   0x00, 0x00,
/* 0xBC */   0x00, 0x00,
/* 0xBD */   0x00, 0x00,
/* 0xBE */   0x00, 0x00,
/* 0xBF */   0x00, 0x00,
/* 0xC0 */   0x00, 0x00,
/* 0xC1 */   0x00, 0x00,
/* 0xC2 */   0x00, 0x00,
/* 0xC3 */   0x00, 0x00,
/* 0xC4 */   0x00, 0x00,
/* 0xC5 */   0x00, 0x00,
/* 0xC6 */   0x00, 0x00,
/* 0xC7 */   0x00, 0x00,
/* 0xC8 */   0x00, 0x00,
/* 0xC9 */   0x00, 0x00,
/* 0xCA */   0x00, 0x00,
/* 0xCB */   0x00, 0x00,
/* 0xCC */   0x00, 0x00,
/* 0xCD */   0x00, 0x00,
/* 0xCE */   0x00, 0x00,
/* 0xCF */   0x00, 0x00,
/* 0xD0 */   0x00, 0x00,
/* 0xD1 */   0x00, 0x00,
/* 0xD2 */   0x00, 0x00,
/* 0xD3 */   0x00, 0x00,
/* 0xD4 */   0x00, 0x00,
/* 0xD5 */   0x00, 0x00,
/* 0xD6 */   0x00, 0x00,
/* 0xD7 */   0x00, 0x00,
/* 0xD8 */   0x00, 0x00,
/* 0xD9 */   0x00, 0x00,
/* 0xDA */   0x00, 0x00,
/* 0xDB */   0x00, 0x00,
/* 0xDC */   0x00, 0x00,
/* 0xDD */   0x00, 0x00,
/* 0xDE */   0x00, 0x00,
/* 0xDF */   0x00, 0x00,
/* 0xE0 */   0x00, 0x00,
/* 0xE1 */   0x00, 0x00,
/* 0xE2 */   0x00, 0x00,
/* 0xE3 */   0x00, 0x00,
/* 0xE4 */   0x00, 0x00,
/* 0xE5 */   0x00, 0x00,
/* 0xE6 */   0x00, 0x00,
/* 0xE7 */   0x00, 0x00,
/* 0xE8 */   0x00, 0x00,
/* 0xE9 */   0x00, 0x00,
/* 0xEA */   0x00, 0x00,
/* 0xEB */   0x00, 0x00,
/* 0xEC */   0x00, 0x00,
/* 0xED */   0x00, 0x00,
/* 0xEE */   0x00, 0x00,
/* 0xEF */   0x00, 0x00,
/* 0xF0 */   0x00, 0x00,
/* 0xF1 */   0x00, 0x00,
/* 0xF2 */   0x00, 0x00,
/* 0xF3 */   0x00, 0x00,
/* 0xF4 */   0x00, 0x00,
/* 0xF5 */   0x00, 0x00,
/* 0xF6 */   0x00, 0x00,
/* 0xF7 */   0x00, 0x00,
/* 0xF8 */   0x00, 0x00,
/* 0xF9 */   0x00, 0x00,
/* 0xFA */   0x00, 0x00,
/* 0xFB */   0x00, 0x00,
/* 0xFC */   0x00, 0x00,
/* 0xFD */   0x00, 0x00,
/* 0xFE */   0x00, 0x00,
/* 0xFF */   0x00, 0x00,

/* Symbol 0x20, offset 512 */
    45, 1, 0,
    0x00, 0x00, 0x00, 0x00, 0x00, 0x00, 

/* Symbol 0x2B, offset 521 */
    31, 58, 29,
    0x00, 0x07, 0xC0, 0x00, 0x00, 0x0F, 0xE0, 0x00, 0x00, 0x0F, 0xE0, 0x00,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 0x00, 

/* Symbol 0x2C, offset 640 */
    8, 70, 62,
    0x3E, 0x3F, 0x7F, 0x7F, 0x7F, 0x7F, 0xFF, 0xFE, 

/* Symbol 0x2D, offset 651 */
    35, 47, 41,
    0x7F, 0xFF, 0xFF, 0xFF, 0xC0, 0x7F, 0xFF, 0xFF, 0xFF, 0xE0, 0xFF, 0xFF, 0xFF, 0xFF, 0xE0, 0xFF, 0xFF, 0xFF, 0xFF, 0xE0, 0xFF, 0xFF, 0xFF, 0xFF, 0xE0, 0x7F, 0xFF, 0xFF, 0xFF, 0xC0, 

/* Symbol 0x2E, offset 684 */
    7, 67, 61,
    0x7C, 0xFE, 0xFE, 0xFE, 0xFE, 0x7C, 

/* Symbol 0x30, offset 693 */
    35, 67, 1,
    0x00, 0x3F, 0xFF, 0x80, 0x00, 0x00, 0xFF, 0xFF, 0xE0, 0x00, 0x03, 0xFF,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 0x00, 

/* Symbol 0x31, offset 1026 */
    21, 67, 1,
    0x00, 0x01, 0xF0, 0x00, 0x03, 0xF8, 0x00, 0x07, 0xF8, 0x00, 0x0F, 0xF8,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 0xF0, 

/* Symbol 0x32, offset 1227 */
    34, 67, 1,
    0x00, 0x1F, 0xF8, 0x00, 0x00, 0x00, 0xFF, 0xFF, 0x00, 0x00, 0x01, 0xFF,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 0x80, 

/* Symbol 0x33, offset 1560 */
    30, 67, 1,
    0x7F, 0xFF, 0x80, 0x00, 0xFF, 0xFF, 0xF0, 0x00, 0xFF, 0xFF, 0xFC, 0x00,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 0x00, 

/* Symbol 0x34, offset 1827 */
    34, 67, 1,
    0x00, 0x3E, 0x00, 0x00, 0x00, 0x00, 0x7E, 0x00, 0x00, 0x00, 0x00, 0x7F,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 0x00, 

/* Symbol 0x35, offset 2160 */
    30, 67, 1,
    0x7F, 0xFF, 0xFF, 0xF8, 0xFF, 0xFF, 0xFF, 0xFC, 0xFF, 0xFF, 0xFF, 0xFC,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 0x00, 

/* Symbol 0x36, offset 2427 */
    34, 67, 1,
    0x00, 0x00, 0x1F, 0x00, 0x00, 0x00, 0x00, 0x7F, 0x80, 0x00, 0x00, 0x01,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 0x00, 

/* Symbol 0x37, offset 2760 */
    34, 67, 1,
    0x7F, 0xFF, 0xFF, 0xFF, 0x80, 0xFF, 0xFF, 0xFF, 0xFF, 0xC0, 0xFF, 0xFF,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 0x00, 

/* Symbol 0x38, offset 3093 */
    34, 67, 1,
    0x00, 0x0F, 0xFC, 0x00, 0x00, 0x00, 0x7F, 0xFF, 0x00, 0x00, 0x00, 0xFF,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 0x00, 

/* Symbol 0x39, offset 3426 */
    34, 67, 1,
    0x00, 0x3F, 0xFF, 0x00, 0x00, 0x01, 0xFF, 0xFF, 0xE0, 0x00, 0x03, 0xFF,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 0x00, 

/* Symbol 0x3A, offset 3759 */
    7, 51, 22,
    0x7C, 0xFE, 0xFE, 0xFE, 0x7C, 0x00, 0x00, 0x00, 0x00, 0x00, 0x00, 0x00, 0x00, 0x00, 0x00, 0x00, 0x00, 0x00, 0x00, 0x00, 0x00, 0x00, 0x00, 0x7C, 0xFE, 0xFE, 0xFE, 0xFE, 0x7C, 

/* Symbol 0x3D, offset 3791 */
    29, 53, 34,
    0xFF, 0xFF, 0xFF, 0xF0, 0xFF, 0xFF, 0xFF, 0xF8, 0xFF, 0xFF, 0xFF, 0xF8,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 0xF8, 

/* Symbol 0x41, offset 3870 */
    39, 67, 1,
    0x00, 0x00, 0x78, 0x00, 0x00, 0x00, 0x00, 0xFC, 0x00, 0x00, 0x00, 0x00,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 0x7C, 

/* Symbol 0x4C, offset 4203 */
    25, 67, 1,
    0x7C, 0x00, 0x00, 0x00, 0xFE, 0x00, 0x00, 0x00, 0xFE, 0x00, 0x00, 0x00,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 0x00, 

/* Symbol 0x4D, offset 4470 */
    43, 67, 1,
    0x7C, 0x00, 0x00, 0x00, 0x03, 0xE0, 0xFE, 0x00, 0x00, 0x00, 0x07, 0xE0,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 0xE0, 

/* Symbol 0x4F, offset 4869 */
    35, 67, 1,
    0x00, 0x3F, 0xFF, 0x80, 0x00, 0x00, 0xFF, 0xFF, 0xE0, 0x00, 0x03, 0xFF,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 0x00, 

/* Symbol 0x55, offset 5202 */
    35, 67, 1,
    0x7C, 0x00, 0x00, 0x07, 0xC0, 0xFE, 0x00, 0x00, 0x0F, 0xE0, 0xFE, 0x00,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 0x00, 

/* Symbol 0x56, offset 5535 */
    39, 67, 1,
    0xF8, 0x00, 0x00, 0x00, 0x7C, 0xFC, 0x00, 0x00, 0x00, 0xFE, 0xFC, 0x00,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 0x00, 

/* Symbol 0x6B, offset 5868 */
    30, 67, 1,
    0x7C, 0x00, 0x00, 0x00, 0xFE, 0x00, 0x00, 0x00, 0xFE, 0x00, 0x00, 0x00,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 0xF8, 

/* Symbol 0x6C, offset 6135 */
    16, 67, 1,
    0x7C, 0x00, 0xFE, 0x00, 0xFE, 0x00, 0xFE, 0x00, 0xFE, 0x00, 0xFE, 0x00,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 0xFE, 

/* Symbol 0x6F, offset 6270 */
    30, 67, 20,
    0x03, 0xFF, 0xFF, 0x00, 0x0F, 0xFF, 0xFF, 0xC0, 0x1F, 0xFF, 0xFF, 0xE0,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 0x00, 
};
